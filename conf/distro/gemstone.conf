## conf/distro/gemstone.conf
```bitbake
LOCALCONF_VERSION = "2"

TCLIBC ??= "${@bb.utils.contains('DISTRO_GEMSTONE_QT_INCLUDED', '1', 'glibc', 'musl', d)}"
DISTRO = "gemstone"
DISTRO_NAME = "Gemstone"
DISTRO_VERSION = "0.0.1"
TARGET_VENDOR = "-gemstone"

SDKPATHINSTALL = "/opt/${DISTRO}/${SDK_VERSION}"
SDK_VERSION[vardepvalue] = "${SDK_VERSION}"
SDK_VENDOR = "-gemstonesdk"
SDK_VERSION = "${@d.getVar('DISTRO_VERSION').replace('snapshot-${METADATA_REVISION}', 'snapshot')}"
SDK_NAME = "${DISTRO}-${TCLIBC}-${SDKMACHINE}-${IMAGE_BASENAME}-${TUNE_PKGARCH}-${MACHINE}"

DISTRO_FEATURES = "\
    ext2 \
    ipv4 \
    keyboard \
    overlayfs \
    usbhost \
    vfat \
    ${@bb.utils.contains('DISTRO_GEMSTONE_QT_INCLUDED', '1', 'opengl vulkan wayland pam alsa pulseaudio', '', d)} \
    "

INIT_MANAGER ?= "${@bb.utils.contains('DISTRO_GEMSTONE_QT_INCLUDED', '1', 'systemd', 'mdev-busybox', d)}"
INITRAMFS_IMAGE ?= "gemstone-image-rd"
INITRAMFS_IMAGE_BUNDLE:intel-corei7-64 = "1"

PREFERRED_PROVIDER_virtual/kernel:beagley-ai ?= "linux-bb.org-rt"
PREFERRED_PROVIDER_virtual/kernel:t3-gem-o1 ?= "linux-t3-gem-o1-rt"
PREFERRED_PROVIDER_virtual/kernel:t3-gem-s1 ?= "linux-t3-gem-s1-rt"

UBOOT_SIGN_KEYDIR = "${GEMSTONE_WORKDIR}/yocto/meta-gemstone/keys"

LICENSE_FLAGS_ACCEPTED += "${@bb.utils.contains('DISTRO_GEMSTONE_QT_INCLUDED', '1', 'commercial', '', d)}"

INHERIT += "create-spdx"
```

## conf/layer.conf
```bitbake
# We have a conf and classes directory, add to BBPATH
BBPATH .= ":${LAYERDIR}"

# We have recipes-* directories, add to BBFILES
BBFILES += "${LAYERDIR}/recipes-*/*/*.bb \
            ${LAYERDIR}/recipes-*/*/*.bbappend"

BBFILES_DYNAMIC += "\
    meta-ti-bsp:${LAYERDIR}/dynamic-layers/meta-ti/recipes-*/*/*.bb \
    meta-ti-bsp:${LAYERDIR}/dynamic-layers/meta-ti/recipes-*/*/*.bbappend \
    intel:${LAYERDIR}/dynamic-layers/meta-intel/recipes-*/*/*.bbappend \
"

BBFILE_COLLECTIONS += "meta-gemstone"
BBFILE_PATTERN_meta-gemstone = "^${LAYERDIR}/"
BBFILE_PRIORITY_meta-gemstone = "6"

LAYERDEPENDS_meta-gemstone = "core"
LAYERSERIES_COMPAT_meta-gemstone = "scarthgap"
```

## conf/machine/include/meta-gemstone.inc
```bitbake
TI_PREFERRED_BSP ?= "gem_o1"

# ==========
# gem_o1
# Kernel 6.12, u-boot 2025.04
# ==========
BSP_KERNEL_PROVIDER:bsp-gem_o1 = "linux-t3-gem-o1-rt"
BSP_KERNEL_VERSION:bsp-gem_o1 = "6.12.%"
BSP_BOOTLOADER_PROVIDER:bsp-gem_o1 = "u-boot-t3-gem-o1"
BSP_BOOTLOADER_VERSION:bsp-gem_o1 = "2025.%"

BSP_SGX_DRIVER_PROVIDER:bsp-gem_o1 = "ti-sgx-ddk-km"
BSP_SGX_DRIVER_VERSION:bsp-gem_o1 = "1.17%"
BSP_SGX_UMLIBS_VERSION:bsp-gem_o1 = "1.17%"
BSP_ROGUE_DRIVER_PROVIDER:bsp-gem_o1 = "ti-img-rogue-driver"
BSP_ROGUE_DRIVER_VERSION:bsp-gem_o1 = "25%"
BSP_ROGUE_UMLIBS_VERSION:bsp-gem_o1 = "25%"
BSP_MESA_PVR_VERSION:bsp-gem_o1 = "24%"
```

## conf/machine/t3-gem-o1-k3r5.conf
```bitbake
#@TYPE: Machine
#@NAME: BeagleY AI (R5F)
#@DESCRIPTION: Machine configuration for the BeagleY AI (R5F core)

require conf/machine/include/k3r5.inc

TI_PREFERRED_BSP ?= "gem_o1"
require conf/machine/include/meta-gemstone.inc

SYSFW_SOC = "j722s"
SYSFW_CONFIG = "evm"
SYSFW_SUFFIX = "hs-fs"

UBOOT_MACHINE = "j722s_evm_r5_defconfig"

UBOOT_CONFIG_FRAGMENTS:bsp-gem_o1 = "am67a_t3_gem_o1_r5_defconfig"
```

## conf/machine/t3-gem-o1.conf
```bitbake
#@TYPE: Machine
#@NAME: T3-GEM-O1
#@DESCRIPTION: Machine configuration for the Gemstone Obsidian board
require conf/machine/include/j722s.inc

TI_PREFERRED_BSP ?= "gem_o1"

require conf/machine/include/meta-gemstone.inc

UBOOT_MACHINE = "j722s_evm_a53_config"

UBOOT_CONFIG_FRAGMENTS:bsp-gem_o1 = "am67a_t3_gem_o1_a53_defconfig"

KERNEL_DEVICETREE_PREFIX = "\
    ti/k3-j722s \
"

KERNEL_DEVICETREE = ""

KERNEL_DEVICETREE:append:bsp-gem_o1 = " \
    ti/k3-am67a-t3-gem-o1-csi0-imx219.dtbo \
    ti/k3-am67a-t3-gem-o1-dsi-rpi-7inch-panel.dtbo \
    ti/k3-am67a-t3-gem-o1-dsi-waveshare-10-1inch-panel.dtbo \
    ti/k3-am67a-t3-gem-o1-dsi-waveshare-11-9inch-panel.dtbo \
    ti/k3-am67a-t3-gem-o1-dsi-waveshare-13-3inch-2lane-panel.dtbo \
    ti/k3-am67a-t3-gem-o1-dsi-waveshare-13-3inch-4lane-panel.dtbo \
    ti/k3-am67a-t3-gem-o1-dsi-waveshare-2-8inch-panel.dtbo \
    ti/k3-am67a-t3-gem-o1-dsi-waveshare-3-4inch-panel.dtbo \
    ti/k3-am67a-t3-gem-o1-dsi-waveshare-4-0inch-c-panel.dtbo \
    ti/k3-am67a-t3-gem-o1-dsi-waveshare-4-0inch-panel.dtbo \
    ti/k3-am67a-t3-gem-o1-dsi-waveshare-5-0inch-panel.dtbo \
    ti/k3-am67a-t3-gem-o1-dsi-waveshare-6-25inch-panel.dtbo \
    ti/k3-am67a-t3-gem-o1-dsi-waveshare-7-9inch-panel.dtbo \
    ti/k3-am67a-t3-gem-o1-dsi-waveshare-7inch-h-panel.dtbo \
    ti/k3-am67a-t3-gem-o1-dsi-waveshare-7inch-panel.dtbo \
    ti/k3-am67a-t3-gem-o1-dsi-waveshare-8-0inch-panel.dtbo \
    ti/k3-am67a-t3-gem-o1-dsi-waveshare-8-8inch-panel.dtbo \
    ti/k3-am67a-t3-gem-o1-gpio-fan.dtbo \
    ti/k3-am67a-t3-gem-o1-i2c1-400000.dtbo \
    ti/k3-am67a-t3-gem-o1-pwm-ecap0-gpio12.dtbo \
    ti/k3-am67a-t3-gem-o1-pwm-ecap1-gpio16.dtbo \
    ti/k3-am67a-t3-gem-o1-pwm-ecap2-gpio18.dtbo \
    ti/k3-am67a-t3-gem-o1-pwm-epwm0-gpio14.dtbo \
    ti/k3-am67a-t3-gem-o1-pwm-epwm0-gpio5-gpio14.dtbo \
    ti/k3-am67a-t3-gem-o1-pwm-epwm0-gpio5.dtbo \
    ti/k3-am67a-t3-gem-o1-pwm-epwm1-gpio13.dtbo \
    ti/k3-am67a-t3-gem-o1-pwm-epwm1-gpio6-gpio13.dtbo \
    ti/k3-am67a-t3-gem-o1-pwm-epwm1-gpio6.dtbo \
    ti/k3-am67a-t3-gem-o1-spidev0-1cs.dtbo \
    ti/k3-am67a-t3-gem-o1-spidev0-2cs.dtbo \
    ti/k3-am67a-t3-gem-o1-uart-ttys0.dtbo \
    ti/k3-am67a-t3-gem-o1-uart-ttys6.dtbo \
    ti/k3-am67a-t3-gem-o1.dtb \
"

MACHINE_GUI_CLASS = "bigscreen"
```

## conf/machine/t3-gem-s1-k3r5.conf
```bitbake
#@TYPE: Machine
#@NAME: T3-GEM-S1 (R5F)
#@DESCRIPTION: Machine configuration for the Gemstone Sapphire board (R5F core)

require conf/machine/include/k3r5.inc

TI_PREFERRED_BSP ?= "gem_s1"
require conf/machine/include/meta-gemstone.inc

SYSFW_SOC = "j722s"
SYSFW_CONFIG = "evm"
SYSFW_SUFFIX = "hs-fs"

UBOOT_MACHINE = "j722s_evm_r5_defconfig"

UBOOT_CONFIG_FRAGMENTS:bsp-gem_s1 = "am67a_t3_gem_s1_r5_defconfig"
```

## conf/machine/t3-gem-s1.conf
```bitbake
#@TYPE: Machine
#@NAME: T3-GEM-S1
#@DESCRIPTION: Machine configuration for the Gemstone Sapphire board
require conf/machine/include/j722s.inc

TI_PREFERRED_BSP ?= "gem_s1"

require conf/machine/include/meta-gemstone.inc

UBOOT_MACHINE = "j722s_evm_a53_config"

UBOOT_CONFIG_FRAGMENTS:bsp-gem_s1 = "am67a_t3_gem_s1_a53_defconfig"

KERNEL_DEVICETREE_PREFIX = "\
    ti/k3-j722s \
"

KERNEL_DEVICETREE = ""

KERNEL_DEVICETREE:append:bsp-gem_s1 = " \
    ti/k3-am67a-t3-gem-s1-csi0-imx219.dtbo \
    ti/k3-am67a-t3-gem-s1-dsi-rpi-7inch-panel.dtbo \
    ti/k3-am67a-t3-gem-s1-spidev0.dtbo \
    ti/k3-am67a-t3-gem-s1-uart-ttyama0.dtbo \
    ti/k3-am67a-t3-gem-s1.dtb \
"

MACHINE_GUI_CLASS = "bigscreen"
```
